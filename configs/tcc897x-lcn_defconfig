## configs/tcc897x-lcn_defconfig
```kconfig
CONFIG_ARM=y
CONFIG_ARCH_TELECHIPS=y
CONFIG_TCC8971_LCN=y
CONFIG_FIT=y
CONFIG_SYS_PROMPT="TCC # "
CONFIG_CMD_USB=y
CONFIG_USB=y
CONFIG_USB_DWC2=y
CONFIG_USB_STORAGE=y
CONFIG_USB_FUNCTION_FASTBOOT=y
CONFIG_FBCON=y
CONFIG_RSA=y
CONFIG_FIT_SIGNATURE=y
CONFIG_DM=y
CONFIG_MOBIS_CHECK_RSA=y
CONFIG_RSA_SOFTWARE_EXP=y
CONFIG_USE_LCD_1920x720=y
```
